## configs/raspberrypi3_wpe_defconfig
```kconfig
BR2_arm=y
BR2_cortex_a53=y
BR2_ARM_FPU_NEON_VFPV4=y
BR2_CCACHE=y
BR2_OPTIMIZE_2=y
BR2_TOOLCHAIN_BUILDROOT_GLIBC=y
BR2_PACKAGE_HOST_LINUX_HEADERS_CUSTOM_4_14=y
BR2_TOOLCHAIN_BUILDROOT_CXX=y
BR2_PACKAGE_HOST_GDB=y
BR2_PACKAGE_HOST_GDB_SIM=y
BR2_ROOTFS_DEVICE_CREATION_DYNAMIC_EUDEV=y
BR2_TARGET_GENERIC_ROOT_PASSWD="root"
BR2_SYSTEM_DHCP="eth0"
BR2_ROOTFS_POST_BUILD_SCRIPT="board/raspberrypi3/post-build.sh"
BR2_ROOTFS_POST_IMAGE_SCRIPT="board/raspberrypi3/post-image.sh"
BR2_ROOTFS_POST_SCRIPT_ARGS="--add-pi3-miniuart-bt-overlay --gpu_mem_1024=200"
BR2_LINUX_KERNEL=y
BR2_LINUX_KERNEL_CUSTOM_TARBALL=y
BR2_LINUX_KERNEL_CUSTOM_TARBALL_LOCATION="$(call github,raspberrypi,linux,6d27aa156c26977dfd079a7107e31670127d17d3)/linux-6d27aa156c26977dfd079a7107e31670127d17d3.tar.gz"
BR2_LINUX_KERNEL_USE_CUSTOM_CONFIG=y
BR2_LINUX_KERNEL_CUSTOM_CONFIG_FILE="board/raspberrypi3/rpi23-linux-4.14.config"
BR2_LINUX_KERNEL_LZ4=y
BR2_LINUX_KERNEL_DTS_SUPPORT=y
BR2_LINUX_KERNEL_INTREE_DTS_NAME="bcm2710-rpi-3-b bcm2710-rpi-3-b-plus bcm2710-rpi-cm3"
BR2_PACKAGE_BUSYBOX_SMP=y
BR2_PACKAGE_GSTREAMER1=y
BR2_PACKAGE_GST1_PLUGINS_BASE_PLUGIN_APP=y
BR2_PACKAGE_GST1_PLUGINS_BASE_PLUGIN_VIDEOCONVERT=y
BR2_PACKAGE_GST1_PLUGINS_BASE_PLUGIN_GIO=y
BR2_PACKAGE_GST1_PLUGINS_GOOD_PLUGIN_AUDIOFX=y
BR2_PACKAGE_GST1_PLUGINS_GOOD_PLUGIN_AUDIOPARSERS=y
BR2_PACKAGE_GST1_PLUGINS_GOOD_PLUGIN_AUTODETECT=y
BR2_PACKAGE_GST1_PLUGINS_GOOD_PLUGIN_DEINTERLACE=y
BR2_PACKAGE_GST1_PLUGINS_GOOD_PLUGIN_ID3DEMUX=y
BR2_PACKAGE_GST1_PLUGINS_GOOD_PLUGIN_INTERLEAVE=y
BR2_PACKAGE_GST1_PLUGINS_GOOD_PLUGIN_MPG123=y
BR2_PACKAGE_GST1_PLUGINS_GOOD_PLUGIN_SOUPHTTPSRC=y
BR2_PACKAGE_GST1_PLUGINS_BAD_PLUGIN_MPEGTSDEMUX=y
BR2_PACKAGE_GST1_PLUGINS_BAD_PLUGIN_VIDEOPARSERS=y
BR2_PACKAGE_GST1_PLUGINS_BAD_PLUGIN_DASH=y
BR2_PACKAGE_GST1_PLUGINS_BAD_PLUGIN_FAAD=y
BR2_PACKAGE_GST1_PLUGINS_BAD_PLUGIN_HLS=y
BR2_PACKAGE_GST1_PLUGINS_BAD_PLUGIN_SMOOTHSTREAMING=y
BR2_PACKAGE_GST_OMX=y
BR2_PACKAGE_WPEFRAMEWORK=y
BR2_PACKAGE_WPEFRAMEWORK_COMPOSITOR=y
BR2_PACKAGE_WPEFRAMEWORK_COMPOSITOR_OUTOFPROCESS=y
BR2_PACKAGE_WPEFRAMEWORK_DHCPSERVER=y
BR2_PACKAGE_WPEFRAMEWORK_LOCATIONSYNC=y
BR2_PACKAGE_WPEFRAMEWORK_LOCATIONSYNC_URI="http://jsonip.metrological.com/?maf=true"
BR2_PACKAGE_WPEFRAMEWORK_MONITOR=y
BR2_PACKAGE_WPEFRAMEWORK_BLUETOOTH=y
BR2_PACKAGE_WPEFRAMEWORK_REMOTECONTROL=y
BR2_PACKAGE_WPEFRAMEWORK_REMOTECONTROL_DEVINPUT=y
BR2_PACKAGE_WPEFRAMEWORK_SNAPSHOT=y
BR2_PACKAGE_WPEFRAMEWORK_TIMESYNC=y
BR2_PACKAGE_WPEFRAMEWORK_TRACECONTROL=y
BR2_PACKAGE_WPEFRAMEWORK_WEBKITBROWSER=y
BR2_PACKAGE_WPEFRAMEWORK_WEBKITBROWSER_STARTURL="http://127.0.0.1:8080"
BR2_PACKAGE_WPEFRAMEWORK_WEBSERVER=y
BR2_PACKAGE_WPEFRAMEWORK_WIFICONTROL=y
BR2_PACKAGE_WPEWEBKIT=y
# BR2_PACKAGE_WPEWEBKIT_USE_ENCRYPTED_MEDIA is not set
BR2_PACKAGE_BITSTREAM_VERA=y
BR2_PACKAGE_RPI_BT_FIRMWARE=y
BR2_PACKAGE_RPI_FIRMWARE=y
BR2_PACKAGE_RPI_WIFI_FIRMWARE=y
# BR2_PACKAGE_EUDEV_ENABLE_HWDB is not set
BR2_PACKAGE_RPI_USERLAND=y
BR2_PACKAGE_CA_CERTIFICATES=y
BR2_PACKAGE_WEBP=y
BR2_PACKAGE_SHARED_MIME_INFO=y
BR2_PACKAGE_DROPBEAR=y
BR2_PACKAGE_GESFTPSERVER=y
# BR2_PACKAGE_IFUPDOWN_SCRIPTS is not set
BR2_PACKAGE_WPA_SUPPLICANT_AP_SUPPORT=y
BR2_PACKAGE_WPA_SUPPLICANT_AUTOSCAN=y
BR2_PACKAGE_WPA_SUPPLICANT_EAP=y
BR2_PACKAGE_WPA_SUPPLICANT_WPS=y
BR2_TARGET_ROOTFS_CPIO_LZ4=y
BR2_TARGET_ROOTFS_INITRAMFS=y
# BR2_TARGET_ROOTFS_TAR is not set
```

## package/bcm-refsw/Config.in
```kconfig
config BR2_PACKAGE_BCM_REFSW
	bool "bcm-refsw"
	depends on BR2_mipsel || BR2_arm || BR2_aarch64
	depends on BR2_INSTALL_LIBSTDCPP
	depends on BR2_TOOLCHAIN_HAS_THREADS
	select BR2_PACKAGE_HAS_LIBEGL
	select BR2_PACKAGE_HAS_LIBGLES
	help
		bcm-refsw


if BR2_PACKAGE_BCM_REFSW

config BR2_PACKAGE_PROVIDES_LIBEGL
	default "bcm-refsw"

config BR2_PACKAGE_PROVIDES_LIBGLES
	default "bcm-refsw"

choice
	prompt "bcm-refsw version"
	default BR2_PACKAGE_BCM_REFSW_18_2
	help
		Select the version you wish to use

    config BR2_PACKAGE_BCM_REFSW_18_2
        bool "bcm-refsw 18.2"
endchoice

choice
	prompt "hardware platform"
	default BR2_PACKAGE_BCM_REFSW_PLATFORM_72604 if BR2_arm

	config BR2_PACKAGE_BCM_REFSW_PLATFORM_72604
		bool "BCM 72604"
		depends on BR2_arm

endchoice

menu "Codec support"
config BR2_PACKAGE_BCM_OPUS_DECODER_SUPPORT
    bool "OPUS decoder"
	default y
    help
       Enable OPUS for other OPUS depending packages.

config BR2_PACKAGE_BCM_VP9_DECODER_SUPPORT
    bool "VP9 decoder"
	default y
    help
       Enable VP9 for other VP9 depending packages.
endmenu

config BR2_PACKAGE_BCM_REFSW_SAGE
	bool "SAGE v3.x"
	default n
	depends on BR2_PACKAGE_BCM_REFSW
	help
	  Add SAGE support in Nexus.

config BR2_PACKAGE_BCM_REFSW_SAGE_PATH
        string "SAGE Path"
        default "/usr/bin/"
        depends on BR2_PACKAGE_BCM_REFSW_SAGE
	help
	  Sage binaries path

config BR2_PACKAGE_BCM_REFSW_PAK_PATH
        string "PAK Path"
        default "/usr/bin/"
        depends on BR2_PACKAGE_BCM_REFSW_18_2
	help
	  PAK binaries path

config BR2_PACKAGE_BCM_REFSW_DRM_PATH
        string "DRM Path"
        default "/usr/bin/"
        depends on BR2_PACKAGE_BCM_REFSW_18_2
	help
	  DRM binaries path

config BR2_PACKAGE_BCM_REFSW_SAGE_MANUFACTURING
        bool "SAGE Manufacturing"
        default n
        depends on BR2_PACKAGE_BCM_REFSW_SAGE
    help
      Sage manufacturing lib for on-field provisioning

config BR2_PACKAGE_BCM_REFSW_SAGE_EXAMPLES
        bool "SAGE examples"
	default n
        depends on BR2_PACKAGE_BCM_REFSW_SAGE
        help
          Sage examples

config BR2_PACKAGE_BCM_REFSW_SAGE_BSECBUF
        bool "SAGE/SVP b_secbuf library"
        default n
        depends on BR2_PACKAGE_BCM_REFSW_SAGE
        help
          Sage/SVP secure library for multiprocess environment

config BR2_PACKAGE_BCM_REFSW_SAGE_PLAYREADY_30
        bool "Playready 3.0 SVP"
        default n
        depends on BR2_PACKAGE_BCM_REFSW_SAGE
        help
          Playready 3.0 SVP

config BR2_PACKAGE_BCM_REFSW_SAGE_PLAYREADY_30_EXAMPLE
        bool "Playready 3.0 SVP example"
        default n
        depends on BR2_PACKAGE_BCM_REFSW_SAGE
        help
          Playready 3.0 SVP example

config BR2_PACKAGE_BCM_REFSW_V3D_DRM
	bool "V3D DRM"
	default n
	depends on BR2_PACKAGE_BCM_REFSW_18_2
        help
          Enable V3D DRM	

config BR2_PACKAGE_BCM_REFSW_EGLCUBE
	bool "eglcube"
	default n
	help
	  Build the EGL cube example, just for test and fun.

config BR2_PACKAGE_BCM_REFSW_PMLIB
	bool "pmlib"
	default n
	help
	  Build the Power Manager library.

config BR2_PACKAGE_BCM_REFSW_NXCLIENT_EXAMPLES
	bool "nxclient-examples"
	default n
	help
	  Build the Nexus client exaples.

config BR2_PACKAGE_BCM_REFSW_BOXMODE
    string "Memory Box Mode"
    depends on BR2_PACKAGE_BCM_REFSW
    help
      Memory box mode, you can find details from release notes per platform

config BR2_PACKAGE_BCM_REFSW_KERNELSPACE_HEADERS
	bool "Kernelspace headers"
	default n
	help
	  Installs kernelspace nexus headers used to build some kernelmodules like greenpeak.

endif
```

## package/wpe/wpebackend-rdk/Config.in
```kconfig
config BR2_PACKAGE_WPEBACKEND_RDK
	bool "wpebackend-rdk"
    select BR2_PACKAGE_WAYLAND_EGL_BNXS if BR2_PACKAGE_BCM_REFSW && BR2_PACKAGE_WESTEROS
	help
	  RDK-specific implementations of the WPEBackend interfaces.
```
